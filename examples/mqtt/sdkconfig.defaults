## examples/pico-mqtt/sdkconfig.defaults
```kconfig
CONFIG_PARTITION_TABLE_SINGLE_APP_LARGE=y
CONFIG_ESP_EVENT_POST_FROM_ISR=n
CONFIG_ESP_SYSTEM_PANIC_PRINT_HALT=y
CONFIG_ESP_MAIN_TASK_STACK_SIZE=16384
CONFIG_MBEDTLS_CHACHA20_C=y
CONFIG_MBEDTLS_HKDF_C=y
CONFIG_PTHREAD_TASK_STACK_SIZE_DEFAULT=16384
```

## examples/pico-simple/main/Kconfig
```kconfig
menu "PQUIC Client"

config PQUIC_SERVER_NAME
    string "Server name or IP"
    default "192.168.0.37"
    help
        Hostname or IP address for the picoquic server.

config PQUIC_SERVER_PORT
    int "Server port"
    default 1234
    help
        UDP port to connect to.

endmenu
```

## examples/pico-simple/sdkconfig.defaults.linux
```kconfig
CONFIG_IDF_TARGET="linux"
CONFIG_ESP_EVENT_POST_FROM_ISR=n
CONFIG_MBEDTLS_CHACHA20_C=y
CONFIG_MBEDTLS_HKDF_C=y
```
